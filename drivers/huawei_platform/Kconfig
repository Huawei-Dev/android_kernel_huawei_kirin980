## drivers/huawei_platform/Kconfig
```kconfig
menu "Huawei Platform Drivers"

menuconfig HUAWEI_PLATFORM
       bool "Huawei platform drivers support"
       default n
       help
       Say yes here to support the huawei platform

if HUAWEI_PLATFORM

source "drivers/huawei_platform/antenna_board_match/Kconfig"
source "drivers/huawei_platform/audio/Kconfig"
source "drivers/huawei_platform/riltcp/Kconfig"
source "drivers/huawei_platform/connectivity/Kconfig"
source "drivers/huawei_platform/devdetect/Kconfig"
source "drivers/huawei_platform/ext_modem/Kconfig"
source "drivers/huawei_platform/inputhub/Kconfig"
source "drivers/huawei_platform/irda/Kconfig"
source "drivers/huawei_platform/log/Kconfig"
source "drivers/huawei_platform/net/Kconfig"
source "drivers/huawei_platform/nfc/Kconfig"
source "drivers/huawei_platform/power/Kconfig"
source "drivers/huawei_platform/sensor/Kconfig"
source "drivers/huawei_platform/storage/Kconfig"
source "drivers/huawei_platform/touthscreen/Kconfig"
source "drivers/huawei_platform/touch_key/Kconfig"
source "drivers/huawei_platform/usb/Kconfig"
source "drivers/huawei_platform/antenna_board_gpio_match/Kconfig"
source "drivers/huawei_platform/madapt/Kconfig"
source "drivers/huawei_platform/emcom/Kconfig"
source "drivers/huawei_platform/dp_aux_switch/Kconfig"
source "drivers/huawei_platform/dp_source/Kconfig"
source "drivers/huawei_platform/rilsim/Kconfig"
source "drivers/huawei_platform/vendor_exception/Kconfig"
source "drivers/huawei_platform/card_tray/Kconfig"
source "drivers/huawei_platform/rmeminspect/Kconfig"
source "drivers/huawei_platform/wakeup/Kconfig"
source "drivers/huawei_platform/multichip_skytone/Kconfig"

source "drivers/huawei_platform/switch/Kconfig"
source "drivers/huawei_platform/spmi_hisi/Kconfig"
source "drivers/huawei_platform/hwzerohung/Kconfig"
source "drivers/huawei_platform/hwxcollie/Kconfig"
source "drivers/huawei_platform/hwusb/Kconfig"
source "drivers/huawei_platform/hwmemcheck/Kconfig"
source "drivers/huawei_platform/hwfdleak/Kconfig"
source "drivers/huawei_platform/hwerecovery/Kconfig"
source "drivers/huawei_platform/cpuload/Kconfig"
source "drivers/huawei_platform/dubai/Kconfig"
endif #HUAWEI_PLATFORM

endmenu
```

## drivers/huawei_platform/hwnet/booster/Kconfig
```kconfig
config HW_BOOSTER
    tristate "Network-related optimization acceleration features."
    default n
    help
      Provide network acceleration, business quality assessment
      and other functions.

config HW_NETWORK_QOE
    tristate "Network-Qoe optimization features."
    default n
    help
      Provide network Qoe feature.
```

## drivers/huawei_platform/net/bastet/Kconfig
```kconfig
menu "Huawei Bastet Support"
	depends on INET && NETFILTER

config HUAWEI_BASTET
	tristate "Huawei Bastet support"
	default n
	---help---
	  This driver provides TCP sequence sync, traffic flow correction, etc. for Huawei Bastet.

config HUAWEI_BASTET_COMM_NEW
	bool "Bastet new Balong comm driver support"
	default n
	---help---
	  This driver provides new Balong modem comm interface for Huawei Bastet.
endmenu
```

## drivers/huawei_platform/power/hardware_monitor/Kconfig
```kconfig
source "drivers/huawei_platform/power/hardware_monitor/smpl/Kconfig"
source "drivers/huawei_platform/power/hardware_monitor/acr_detect/Kconfig"
source "drivers/huawei_platform/power/hardware_monitor/uscp/Kconfig"
source "drivers/huawei_platform/power/hardware_monitor/water_check/Kconfig"
source "drivers/huawei_platform/power/hardware_monitor/soc_control/Kconfig"
```

## mm/hisi/Kconfig
```kconfig
menuconfig HISI_MM
	bool "Hisilicon MM support"
	---help---
	  This option add some hisilicon mm codes, needed by following modules.

if HISI_MM

config HISI_SLOW_PATH_COUNT
	bool "page alloc enter slow path count"
	default n
	help
	  Say 'Y' here is you want to count page alloc slow path.

endif

config HISI_PMALLOC
	bool "Protectable Memory Allocator"
	default y
	depends on MMU
	depends on HISI_MM
	select  GENERIC_ALLOCATOR
	help
	It allows to write-protect variables allocated dynamically
	ls /sys/kernel/pmalloc

config DEBUG_HISI_PMALLOC
	bool "Tests for Protectable Memory Allocator"
	default y
	depends on HISI_PMALLOC && HISI_HHEE_DEBUG
	help
	Various entries are listed under /sys/kernel/debug/pmalloc

config HISI_QOS_MEM_OPT
	bool "Qos memory alloc opt"
	default n
	depends on HW_QOS_THREAD || HW_VIP_THREAD
	help
	  key process memory alloc opt

config HUAWEI_UNMOVABLE_ISOLATE
	bool "Isolate the unmovable memory."
	depends on ARM64
	default n
	  help
	  Isolate the unmovable memory from others migrate types.
	  So that we can improve the success rate of compact.

	  If unsure, say "n".

config HUAWEI_UNMOVABLE_ISOLATE1_SIZE_MBYTES
	int "Size in Mega Bytes For UNMOVABLE_ISOLATE1"
	depends on HUAWEI_UNMOVABLE_ISOLATE
	default 64
	help
	  Defines the size (in MiB) of the default memory area for
	  MIGRATE_UNMOVABLE_ISOLATE1 Memory Allocator. However,
	  we should parse the size from /proc/cmdline firstly.

config HUAWEI_UNMOVABLE_ISOLATE2_SIZE_MBYTES
	int "Size in Mega Bytes For UNMOVABLE_ISOLATE2"
	depends on HUAWEI_UNMOVABLE_ISOLATE
	default 64
	help
	  Defines the size (in MiB) of the default memory area for
	  MIGRATE_UNMOVABLE_ISOLATE2 Memory Allocator. However,
	  we should parse the size from /proc/cmdline firstly.

config HISI_PAGECACHE_HELPER
	tristate "KIRIN page cache helper module"
	default n

	---help---
	This selects the Kirin page cache helper module.

	Select this if you want to optimize your Android system.
	If unsure, say N.

config HISI_PAGECACHE_DEBUG
	tristate "KIRIN page cache trace module"
	default n
	depends on HISI_DEBUG_FS

	---help---
	This selects the Kirin page cache trace module.

	Select this if you want to optimize your Android system.
	If unsure, say N.
```
